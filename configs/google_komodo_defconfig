## configs/google_komodo_defconfig
```kconfig
CONFIG_ARM=y
CONFIG_SKIP_LOWLEVEL_INIT=y
CONFIG_COUNTER_FREQUENCY=26000000
CONFIG_POSITION_INDEPENDENT=y
CONFIG_ARCH_EXYNOS=y
CONFIG_SYS_MALLOC_LEN=0x2000000
CONFIG_SYS_MALLOC_F_LEN=0x16000
CONFIG_TARGET_EXYNOS_MOBILE=y
CONFIG_NR_DRAM_BANKS=8
CONFIG_DEFAULT_DEVICE_TREE="zumapro-komodo"
CONFIG_SYS_BOOTM_LEN=0x2000000
CONFIG_SYS_LOAD_ADDR=0x80000000
CONFIG_DEBUG_UART_BASE=0x10870000
CONFIG_DEBUG_UART_CLOCK=24576000
CONFIG_ARMV8_CNTFRQ_BROKEN=y
CONFIG_ARMV8_PSCI=y
CONFIG_ARMV8_PSCI_NR_CPUS=10
CONFIG_DEBUG_UART=y
CONFIG_LOCALVERSION="-zuma"
# CONFIG_LOCALVERSION_AUTO is not set
CONFIG_EFI_RUNTIME_UPDATE_CAPSULE=y
CONFIG_EFI_CAPSULE_ON_DISK=y
CONFIG_EFI_CAPSULE_ON_DISK_EARLY=y
CONFIG_EFI_CAPSULE_FIRMWARE_RAW=y
# CONFIG_TIMESTAMP is not set
CONFIG_BUTTON_CMD=y
CONFIG_FIT=y
# CONFIG_EXPO is not set
CONFIG_SUPPORT_RAW_INITRD=y
CONFIG_USE_PREBOOT=y
CONFIG_SAVE_PREV_BL_FDT_ADDR=y
CONFIG_SAVE_PREV_BL_INITRAMFS_START_ADDR=y
CONFIG_SYS_PBSIZE=1024
CONFIG_BOARD_TYPES=y
# CONFIG_DISPLAY_CPUINFO is not set
CONFIG_MISC_INIT_R=y
CONFIG_HUSH_PARSER=y
CONFIG_CMD_BDINFO_EXTRA=y
CONFIG_CMD_CONFIG=y
CONFIG_CMD_UFETCH=y
CONFIG_CMD_HISTORY=y
CONFIG_CMD_LICENSE=y
CONFIG_CMD_SM3SUM=y
CONFIG_CMD_BOOTEFI_SELFTEST=y
CONFIG_CMD_BOOTMENU=y
CONFIG_CMD_BOOTAPPENDED=y
CONFIG_APPENDED_PAYLOAD_BASE=0xa0011000
CONFIG_CMD_2048=y
CONFIG_CMD_BMP=y
CONFIG_CMD_CACHE=y
CONFIG_CMD_CONITRACE=y
CONFIG_CMD_EFIDEBUG=y
CONFIG_CMD_EXCEPTION=y
CONFIG_CMD_INI=y
CONFIG_CMD_TIME=y
CONFIG_CMD_GETTIME=y
CONFIG_CMD_PAUSE=y
CONFIG_CMD_RNG=y
CONFIG_CMD_KASLRSEED=y
CONFIG_CMD_TIMER=y
CONFIG_CMD_SYSBOOT=y
CONFIG_CMD_PSTORE=y
CONFIG_CMD_PSTORE_MEM_ADDR=0xfd3ff000
CONFIG_CMD_PSTORE_MEM_SIZE=0x40000
CONFIG_CMD_PSTORE_CONSOLE_SIZE=0x20000
CONFIG_CMD_TERMINAL=y
CONFIG_CMD_UUID=y
CONFIG_CMD_SELECT_FONT=y
CONFIG_CMD_FS_GENERIC=y
# CONFIG_DOS_PARTITION is not set
CONFIG_EFI_PARTITION=y
CONFIG_OF_BOARD=y
CONFIG_ENV_RELOC_GD_ENV_ADDR=y
CONFIG_BLKMAP=y
CONFIG_BUTTON_REMAP_PHONE_KEYS=y
CONFIG_CLK_EXYNOS_ZUMA=y
CONFIG_DFU_MMC=y
CONFIG_SYS_DFU_DATA_BUF_SIZE=0x200000
CONFIG_USB_FUNCTION_FASTBOOT=y
CONFIG_USB_FUNCTION_ACM=y
CONFIG_FASTBOOT_BUF_ADDR=0xdead0000
CONFIG_FASTBOOT_FLASH=y
CONFIG_FASTBOOT_FLASH_MMC_DEV=0
CONFIG_ARM_FFA_TRANSPORT=y
CONFIG_SCMI_FIRMWARE=y
CONFIG_SYS_I2C_S3C24X0=y
CONFIG_BUTTON_KEYBOARD=y
CONFIG_MMC_BROKEN_CD=y
CONFIG_MMC_IO_VOLTAGE=y
CONFIG_MMC_UHS_SUPPORT=y
CONFIG_MMC_HS400_SUPPORT=y
CONFIG_MMC_DW=y
CONFIG_PHY=y
CONFIG_PHY_EXYNOS_USBDRD=y
CONFIG_PHY_ZUMA_EUSB2=y
CONFIG_PINCTRL=y
CONFIG_PINCTRL_EXYNOS_ZUMA=y
CONFIG_DM_PMIC=y
CONFIG_PMIC_S2MPS11=y
CONFIG_DM_REGULATOR=y
CONFIG_DM_REGULATOR_FIXED=y
CONFIG_DM_REGULATOR_S2MPS11=y
CONFIG_DM_RNG=y
CONFIG_RNG_EXYNOS=y
CONFIG_DM_RTC=y
CONFIG_DEBUG_UART_SKIP_INIT=y
CONFIG_SOC_SAMSUNG=y
CONFIG_EXYNOS_PMU=y
CONFIG_EXYNOS_USI=y
CONFIG_SYSRESET=y
CONFIG_SYSRESET_CMD_POWEROFF=y
CONFIG_SYSRESET_SYSCON=y
CONFIG_ARM_SMCCC=y
CONFIG_SYSRESET_PSCI=y
CONFIG_USB=y
CONFIG_DM_USB_GADGET=y
CONFIG_USB_DWC3=y
CONFIG_USB_DWC3_GENERIC=y
CONFIG_USB_GADGET=y
CONFIG_USB_GADGET_MANUFACTURER="Google"
CONFIG_USB_GADGET_VENDOR_NUM=0x18d1
CONFIG_USB_GADGET_PRODUCT_NUM=0x4ee0
CONFIG_VIDEO=y
# CONFIG_VIDEO_FONT_8X16 is not set
CONFIG_VIDEO_FONT_16X32=y
CONFIG_VIDEO_SIMPLE=y
# CONFIG_VIDEO_DAMAGE is not set
# CONFIG_REQUIRE_SERIAL_CONSOLE is not set
CONFIG_FS_EXT4=y
CONFIG_FS_FAT=y
# CONFIG_SHA256 is not set
```

## configs/mt6768_defconfig
```kconfig
CONFIG_ARM=y
CONFIG_COUNTER_FREQUENCY=13000000
CONFIG_POSITION_INDEPENDENT=y
CONFIG_ARCH_MEDIATEK=y
CONFIG_TEXT_BASE=0x40080000
CONFIG_SYS_MALLOC_F_LEN=0x4000
CONFIG_NR_DRAM_BANKS=1
CONFIG_ENV_SIZE=0x1000
CONFIG_DEFAULT_DEVICE_TREE="mt6768-generic"
CONFIG_TARGET_MT6768=y
CONFIG_XIAOMI_LANCELOT=y
CONFIG_SYS_LOAD_ADDR=0x48000000
CONFIG_DEBUG_UART_BASE=0x11002000
CONFIG_DEBUG_UART_CLOCK=26000000
CONFIG_DEBUG_UART=y
CONFIG_DEBUG_UART_ANNOUNCE=y
CONFIG_SERIAL_MEMLOG=y
CONFIG_DEBUG_UART_MEMLOG=y
CONFIG_BAUDRATE=921600
CONFIG_DM_SERIAL=y
# CONFIG_MTK_SERIAL is not set
CONFIG_DM_GPIO=y
CONFIG_CLK=y
CONFIG_CLK_CCF=y
CONFIG_DEVRES=y
CONFIG_OF_LIBFDT_OVERLAY=y
# Call ft_board_setup() before handing the dtb to Linux; that is where the real
# 3 GiB of RAM is declared (arch/arm/mach-mediatek/mt6768/init.c).
CONFIG_OF_BOARD_SETUP=y
# Preserve register x0 at U-Boot entry = the address of the real FDT LK hands
# on (0x4bc80000). Without this save_prev_bl_data.o is not linked in and
# get_prev_bl_fdt_addr() is only a macro returning 0.
CONFIG_SAVE_PREV_BL_FDT_ADDR=y
CONFIG_FIT=y
CONFIG_HUSH_PARSER=y
CONFIG_SYS_CBSIZE=256
CONFIG_SYS_PBSIZE=276
# CONFIG_PSCI_RESET is not set
# CONFIG_EFI_LOADER is not set
# CONFIG_DISPLAY_BOARDINFO is not set
# CONFIG_ARCH_FIXUP_FDT_MEMORY is not set
CONFIG_CMD_MMC=y
CONFIG_CMD_PART=y
CONFIG_CMD_GPT=y
CONFIG_CMD_EXT4=y
CONFIG_CMD_FAT=y
CONFIG_CMD_FS_GENERIC=y
CONFIG_CMD_BOOTI=y
CONFIG_MMC_MTK=y
CONFIG_PHY=y
CONFIG_PHY_MTK_TPHY=y
CONFIG_USB=y
CONFIG_DM_USB_GADGET=y
CONFIG_USB_MUSB_HOST=n
CONFIG_USB_MUSB_GADGET=y
CONFIG_USB_MUSB_MT6768=y
CONFIG_USB_GADGET=y
CONFIG_USB_GADGET_VENDOR_NUM=0x0e8d
CONFIG_USB_GADGET_PRODUCT_NUM=0x201c
CONFIG_USB_ETHER=y
CONFIG_WDT=y
CONFIG_WDT_MTK=y
# CONFIG_POWER is not set
# CONFIG_INPUT is not set
# CONFIG_RANDOM_UUID is not set
CONFIG_LINUX_KERNEL_IMAGE_HEADER=y
CONFIG_LNX_KRNL_IMG_TEXT_OFFSET_BASE=0x40000000
CONFIG_DM_VIDEO=y
CONFIG_VIDEO=y
CONFIG_VIDEO_SIMPLE=y
CONFIG_VIDEO_FONT_8X16=y
CONFIG_CONSOLE_SCROLL_LINES=5
CONFIG_SYS_WHITE_ON_BLACK=y
CONFIG_CONSOLE_MUX=y
CONFIG_BOARD_EARLY_INIT_F=y
CONFIG_BOARD_LATE_INIT=y
CONFIG_BOOTDELAY=2
CONFIG_BOOTCOMMAND="echo ==== copying dtb somewhere safe ====; cp.b 0x4a080000 0x60000000 0x10000; echo ==== BOOTI LINUX 6.18 ====; sleep 3; booti 0x47c80000 - 0x60000000; echo ==== BOOTI FAILED, RESET IN 30s ====; sleep 30; reset"
CONFIG_USE_BOOTCOMMAND=y
CONFIG_CMD_FASTBOOT=y
CONFIG_USB_FUNCTION_FASTBOOT=y
CONFIG_FASTBOOT_BUF_ADDR=0x45000000
CONFIG_FASTBOOT_BUF_SIZE=0x08000000
CONFIG_FASTBOOT_FLASH=y
CONFIG_FASTBOOT_FLASH_MMC_DEV=0
```
